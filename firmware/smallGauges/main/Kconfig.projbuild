## firmware/smallGauges/main/Kconfig.projbuild
```kconfig
menu "Gauge Cluster Configuration"

    choice GAUGE_VARIANT
        prompt "Gauge Variant"
        default GAUGE_VARIANT_1
        help
            Select which hardware/UI gauge layout variant to compile.

        config GAUGE_VARIANT_1
            bool "Gauge 1"

        config GAUGE_VARIANT_2
            bool "Gauge 2"

        config GAUGE_VARIANT_3
            bool "Gauge 3"

        config GAUGE_VARIANT_4
            bool "Gauge 4"

        config GAUGE_VARIANT_5
            bool "Gauge 5"
    endchoice

    config APP_PROJECT_NAME
        string "Application Project Name"
        default "smallGauge1" if GAUGE_VARIANT_1
        default "smallGauge2" if GAUGE_VARIANT_2
        default "smallGauge3" if GAUGE_VARIANT_3
        default "smallGauge4" if GAUGE_VARIANT_4
        default "smallGauge5" if GAUGE_VARIANT_5

endmenu
```
